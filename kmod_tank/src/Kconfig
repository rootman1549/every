## kmod_tank/src/Kconfig
```kconfig
config TANK
　　tristate "tank project , XXMedia inc , all rights has reserved"
　　default n
　　help
　　　this is a kernel module for tank project.
　　　If unsure, say N.
```
